## config/boards/shields/Seaside39/Kconfig.defconfig
```kconfig
if SHIELD_Seaside39_R

config ZMK_KEYBOARD_NAME
    default "Seaside39_R"

config ZMK_SPLIT
    default y

config ZMK_SPLIT_ROLE_CENTRAL
    default y

endif

if SHIELD_Seaside39_L

config ZMK_KEYBOARD_NAME
    default "Seaside39_L"

config ZMK_SPLIT
    default y

endif
```

## config/boards/shields/Seaside39/Kconfig.shield
```kconfig
config SHIELD_Seaside39_R
    def_bool $(shields_list_contains,Seaside39_R)

config SHIELD_Seaside39_L
    def_bool $(shields_list_contains,Seaside39_L)
```
